## Kconfig
```kconfig
#
# Copyright (c) 2021 Circuit Dojo LLC
#

menu "Air Quality Wing"
rsource "drivers/Kconfig"
rsource "lib/Kconfig"
endmenu
```

## drivers/Kconfig
```kconfig
#
# Copyright (c) 2021 Circuit Dojo LLC
#

rsource "sgp40/Kconfig"
rsource "hpma115s0/Kconfig"
rsource "shtc3/Kconfig"
```

## drivers/hpma115s0/Kconfig
```kconfig
#
# Copyright (c) 2021 Circuit Dojo LLC
#

menuconfig HPMA115S0
	bool "Honeywell HPMA115S0 Particulate Sensor"
	depends on I2C
	help
	  Enable driver for Honeywell's HPMA115S0 particulate sensors.
```

## drivers/sgp40/Kconfig
```kconfig
#
# Copyright (c) 2021 Circuit Dojo LLC
#

menuconfig SGP40_CD
	bool "SGP40 TVOC Sensor"
	depends on I2C
	help
	  Enable driver for SGP40 TVOC sensors.

if SGP40_CD

config SGP40_DRV_NAME
	string "Sensirion SGP40 Driver's name"
	default "SGP40"
	help
	  This option sets the driver name

endif # SGP40_CD
```

## drivers/shtc3/Kconfig
```kconfig
#
# Copyright (c) 2021 Circuit Dojo LLC
#

menuconfig SHTC3
	bool "SHTC3 Temperature and Humidity Sensor"
	depends on I2C
	help
	  Enable driver for SHTC3 temperature/humidity sensor.

if SHTC3

config SHTC3_DRV_NAME
	string "Sensirion SHTC3 Driver's name"
	default "SHTC3"
	help
	  This option sets the driver name

endif # SHTC3
```

## dts/bindings/honeywell,hpma115s0.yaml
```yaml
#
# Copyright (c) 2021 Circuit Dojo LLC
#


description: Honeywell HPMA115S0 Particulate Sensor

compatible: "honeywell,hpma115s0"

include: uart-device.yaml

properties:
    enable-gpios:
      type: phandle-array
      required: false
      description: |
        (Optional) power enable for the HPMA115S0.
```

## dts/bindings/sensirion,sgp40.yaml
```yaml
#
# Copyright (c) 2021 Circuit Dojo LLC
#


description: Sensirion SGP40 TVOC Sensor

compatible: "sensirion,sgp40"

include: i2c-device.yaml

properties:
    enable-gpios:
      type: phandle-array
      required: false
      description: |
        (Optional) power enable for the SGP40.
```

## dts/bindings/sensirion,sgp40cd.yaml
```yaml
#
# Copyright (c) 2021 Circuit Dojo LLC
#


description: Sensirion SGP40 TVOC Sensor

compatible: "sensirion,sgp40cd"

include: i2c-device.yaml

properties:
    enable-gpios:
      type: phandle-array
      required: false
      description: |
        (Optional) power enable for the SGP40.
```

## dts/bindings/sensirion,shtc3.yaml
```yaml
#
# Copyright (c) 2021 Circuit Dojo LLC
#

description: Sensirion SHTC3 Temp/Humidity Sensor

compatible: "sensirion,shtc3"

include: i2c-device.yaml
```

## dts/bindings/sensirion,shtc3cd.yaml
```yaml
#
# Copyright (c) 2021 Circuit Dojo LLC
#

description: Sensirion SHTC3 Temp/Humidity Sensor

compatible: "sensirion,shtc3cd"

include: i2c-device.yaml
```

## lib/Kconfig
```kconfig
#
# Copyright (c) 2021 Circuit Dojo LLC
#

menuconfig AQW
	bool "Air Quality Wing Sensor Library"
	help
	  Enable Air Quality Wing sensor library.

if AQW

# Module logging
module = AQW
module-str = aqw
source "subsys/logging/Kconfig.template.log_config"

rsource "codec/Kconfig"

endif # AQW
```

## lib/codec/Kconfig
```kconfig
menuconfig AQW_CODEC
	bool "Air Quality Wing Codec Library"
	select QCBOR
	help
	  Enable Air Quality Wing codec library.
```

## west.yml
```yaml
manifest:
  projects:
    # Sensirion algoritm
    - name: embedded-sgp
      path: aqw/ext/embedded-sgp
      revision: 4f69c0d8e2f7192aeaf0d268211b1f54af50146b
      url: https://github.com/Sensirion/embedded-sgp.git
  self:
    # This repository should be cloned to 
    path: aqw
```
